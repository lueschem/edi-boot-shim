## template/boot.scr.its
```
/dts-v1/;
  
/ {
    description = "edi-boot-shim boot script";
    #address-cells = <1>;
  
    images {
        default@1 {
            description = "default setup";
            data = /incbin/("__BOOT_COMMAND_SCRIPT__");
            type = "script";
            arch = "__U_BOOT_ARCHITECTURE__";
            compression = "none";
            hash@1 {
                algo = "sha1";
            };
        };
    };
};
```

## template/uimage.cl-som-imx7.its
```
/dts-v1/;

/ {
    description = "U-Boot fitImage for cl-som-imx7 (__KERNEL_PACKAGE_VERSION__)";
    #address-cells = <1>;

    images {
        kernel-0 {
            description = "Linux kernel";
            data = /incbin/("/boot/vmlinuz-__KERNEL_PACKAGE_VERSION__");
            type = "kernel";
            arch = "arm";
            os = "linux";
            load = <0x80800000>;
            entry = <0x80800000>;
            compression = "none";
            hash-1 {
                algo = "sha1";
            };
        };
        fdt-0 {
            description = "device tree blob";
            data = /incbin/("/usr/lib/linux-image-__KERNEL_PACKAGE_VERSION__/imx7d-sbc-iot-imx7.dtb");
            type = "flat_dt";
            arch = "arm";
            load = <0x83000000>;
            entry = <0x83000000>;
            compression = "none";
            hash-1 {
                algo = "sha1";
            };
        };
        ramdisk-0 {
            description = "ramdisk";
            data = /incbin/("/boot/initrd.img-__KERNEL_PACKAGE_VERSION__");
            type = "ramdisk";
            arch = "arm";
            os = "linux";
            compression = "gzip";
            hash-1 {
                algo = "sha1";
            };
        };
    };
    configurations {
        default = "conf-1";
        conf-1 {
            description = "boot Linux kernel with dtb and ramdisk";
            kernel = "kernel-0";
            fdt = "fdt-0";
            ramdisk = "ramdisk-0";
            signature-1 {
                algo = "sha1,rsa2048";
                key-name-hint = "fit-key";
                sign-images = "fdt", "kernel", "ramdisk";
            };
        };
    };
};
```
